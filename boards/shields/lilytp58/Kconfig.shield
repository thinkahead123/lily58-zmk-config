## boards/shields/lilytp58/Kconfig.shield
```kconfig
# Copyright (c) 2020 Pete Johanson
# SPDX-License-Identifier: MIT

config SHIELD_LILYTP58_LEFT
    def_bool $(shields_list_contains,lilytp58_left)

config SHIELD_LILYTP58_RIGHT
    def_bool $(shields_list_contains,lilytp58_right)
```
